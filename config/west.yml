## config/west.yml
```yaml
manifest:
  defaults:
    revision: main
  remotes:
    - name: zmkfirmware
      url-base: https://github.com/zmkfirmware
    - name: Good-Great-Grand-Wonderful
      url-base: https://github.com/Good-Great-Grand-Wonderful
  projects:
    - name: zmk
      remote: zmkfirmware
      revision: ff09f2d0c9f13a868c8f71d71d9348ade438e4b6
      import: app/west.yml
    - name: gggw-zmk-keebs
      remote: Good-Great-Grand-Wonderful
      revision: zephyr-4.1
      import: config/west.yml
  self:
    path: config
```
